## Kconfig
```kconfig
mainmenu "RT-Thread Project Configuration"

config BSP_DIR
    string
    option env="BSP_ROOT"
    default "."

config RTT_DIR
    string
    option env="RTT_ROOT"
    default "./vendor/rt-thread"

config PKGS_DIR
    string
    option env="PKGS_ROOT"
    default "packages"

source "$BSP_DIR/app/Kconfig"
source "$BSP_DIR/vendor/Kconfig"
source "$RTT_DIR/Kconfig"
source "$PKGS_DIR/Kconfig"
```

## app/Kconfig
```kconfig
config RT_USING_USER_MAIN
  bool
  default y

menu "App components"
  source "$BSP_DIR/app/tension/Kconfig"
  source "$BSP_DIR/app/tilt/Kconfig"
endmenu

config RT_USING_LORAWAN
  depends on APP_COMPONENTS_TENSION || APP_COMPONENTS_TILT
  bool
  default y
```

## app/tension/Kconfig
```kconfig
menuconfig APP_COMPONENTS_TENSION
  bool "Tension app"
  default n
  select RT_USING_BQ24040
  select RT_USING_BQ24040_CHARGE
  select RT_USING_ADS1232
  select RT_USING_PIN

if APP_COMPONENTS_TENSION
# TODO dts
choice APP_TENSION_ADC
  prompt "bq24040 using adc"
  default APP_TENSION_ADC0
  config APP_TENSION_ADC0
    bool "adc0"
    select BSP_USING_ADC0
endchoice

config RT_USING_BQ24040_CHARGE_CHG
  string
  default "PA.11"

config RT_USING_BQ24040_CHARGE_PG
  string
  default "PA.12"

endif
```

## app/tilt/Kconfig
```kconfig
menuconfig APP_COMPONENTS_TILT
  bool "Tilt app"
  default n
  select RT_USING_BQ24040
  select RT_USING_ADXL355
  select RT_USING_PIN

if APP_COMPONENTS_TILT
# TODO dts
choice APP_TILT_ADC
  prompt "bq24040 using adc"
  default APP_TILT_ADC0
  config APP_TILT_ADC0
    bool "adc0"
    select BSP_USING_ADC0
endchoice

endif
```

## vendor/Kconfig
```kconfig
source "$BSP_DIR/vendor/lorawan/Kconfig"
source "$BSP_DIR/vendor/lora-radio/Kconfig"

menu "BSP Components"

choice BSP_COMPONENTS
  prompt "BSP"
  default SOC_SERIES_GD32E10X
  config SOC_SERIES_GD32E10X
    bool "gd32e10x"
  config SOC_SERIES_GD32E20X
    bool "gd32e20x"
endchoice

source "$BSP_DIR/vendor/gd32e10x-bsp/Kconfig"

endmenu

source "$BSP_DIR/vendor/sensor/bq24040/Kconfig"
source "$BSP_DIR/vendor/sensor/ads1232/Kconfig"
```

## vendor/gd32e10x-bsp/Kconfig
```kconfig
config SOC_SERIES_GD32E10X
   bool
   default n
   select RT_USING_COMPONENTS_INIT
   select RT_USING_SERIAL

choice BSP_USING_SERIAL
   depends on SOC_SERIES_GD32E10X
   prompt "RT using serial"
   default BSP_USING_UART1
   config BSP_USING_UART0
      bool "uart0"
   config BSP_USING_UART1
      bool "uart1"
endchoice

config BSP_USING_ADC0
   bool
   default n

config BSP_USING_ADC1
   bool
   default n
```

## vendor/lora-radio/Kconfig
```kconfig
config RT_USING_LORA_RADIO
  bool
  depends on RT_USING_LORAWAN
  default y

choice RT_USING_LORA_RADIO_DEVICE
  prompt "Lora radio device"
  depends on RT_USING_LORA_RADIO
  default RT_USING_SX126X
  config RT_USING_SX126X
    bool "sx126x"
endchoice

source "$BSP_DIR/vendor/lora-radio/sx126x/Kconfig"
```

## vendor/lora-radio/sx126x/Kconfig
```kconfig
config RT_USING_SX126X
  bool
  default n
  select RT_USING_SPI
  select RT_USING_PIN
```

## vendor/lorawan/Kconfig
```kconfig
config RT_USING_LORAWAN
  bool
  default n

menu "Lorawan"
  depends on RT_USING_LORAWAN

  choice RT_USING_LORAWAN_FREQUENCY_PLANS
  depends on RT_USING_LORAWAN
  prompt "Lorawan frqeuency plans"
  default RT_USING_LORAWAN_FREQUENCY_PLANS_CN470

  config RT_USING_LORAWAN_FREQUENCY_PLANS_CN470
    bool "cn470"

  endchoice

endmenu
```

## vendor/sensor/bq24040/Kconfig
```kconfig
config RT_USING_BQ24040 
  bool
  default n
  select RT_USING_ADC
  select RT_USING_PIN

menu "BQ24040"
depends on RT_USING_BQ24040

config RT_USING_BQ24040_CHARGE
  bool "enable charge"
  default n

config RT_USING_BQ24040_CHARGE_CHG
  depends on RT_USING_BQ24040_CHARGE
  string "gpio chg"

config RT_USING_BQ24040_CHARGE_PG
  depends on RT_USING_BQ24040_CHARGE
  string "gpio pg"

endmenu
```
